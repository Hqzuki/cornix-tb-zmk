/* SPDX-License-Identifier: MIT
 * ZMK selects this board-level keymap for the Cornix boards (it wins over the
 * shield keymap). The right-half central build defines
 * CORNIX_TB_RIGHT_CENTRAL_KEYMAP in its shield overlay, so it gets the real TB
 * keymap; peripheral builds keep the inert placeholder below.
 */
#ifdef CORNIX_TB_RIGHT_CENTRAL_KEYMAP
#include "../../shields/cornix_tb_right_central/cornix_tb_right_central.keymap"
#else
#include <behaviors.dtsi>
/ {
    keymap {
        compatible = "zmk,keymap";
        peripheral {
            bindings = <
&none &none &none &none &none &none &none &none &none &none &none &none
&none &none &none &none &none &none &none &none &none &none &none &none
&none &none &none &none &none &none &none &none &none &none &none &none &none &none
&none &none &none &none &none &none &none &none &none &none &none
            >;
        };
    };
};
#endif
