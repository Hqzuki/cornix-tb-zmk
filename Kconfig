## boards/shields/cornix_tb_right_central/Kconfig.shield
```kconfig
# SPDX-License-Identifier: MIT
config SHIELD_CORNIX_TB_RIGHT_CENTRAL
    def_bool $(shields_list_contains,cornix_tb_right_central)
```

## boards/shields/cornix_tb_trackball_peripheral/Kconfig.shield
```kconfig
# SPDX-License-Identifier: MIT
config SHIELD_CORNIX_TB_TRACKBALL_PERIPHERAL
    def_bool $(shields_list_contains,cornix_tb_trackball_peripheral)
```

## dts/bindings/behaviors/custom,behavior-precision.yaml
```yaml
# SPDX-License-Identifier: MIT
description: Hold to slow the pointer (pairs with custom,input-processor-precision)
compatible: "custom,behavior-precision"
include: zero_param.yaml
```

## dts/bindings/input/cornix,paw3222-gpio.yaml
```yaml
# SPDX-License-Identifier: MIT
# Three-wire half-duplex SDIO, with signal roles detected at every boot.
description: Cornix PAW3222 optical sensor with GPIO three-wire transport
compatible: "cornix,paw3222-gpio"
include: base.yaml
properties:
  autodetect-gpios:
    type: phandle-array
    required: true
    description: Exactly four signal GPIOs to permute as SCK, SDIO, NCS and MOTION
  poll-interval-ms:
    type: int
    default: 15
  res-cpi:
    type: int
    default: 1216
    description: Resolution in multiples of 38 CPI, from 608 to 4826
  deadzone:
    type: int
    default: 1
    description: Per-axis raw-count deadzone; sub-threshold deltas are accumulated and cancelling jitter is discarded
  output-divisor:
    type: int
    default: 1
    description: Divide reported motion (remainder carried); effective CPI = res-cpi / output-divisor
```

## dts/bindings/input_processors/cornix,input-processor-cursor-acceleration.yaml
```yaml
# SPDX-License-Identifier: MIT
description: Mouse-layer-only velocity-scaled cursor acceleration
compatible: "cornix,input-processor-cursor-acceleration"
include: ip_zero_param.yaml
properties:
  mouse-layer:
    type: int
    required: true
  start-delta:
    type: int
    required: true
    description: Movement magnitude where acceleration starts
  max-delta:
    type: int
    required: true
    description: Movement magnitude where maximum acceleration is reached
  max-multiplier:
    type: int
    required: true
    description: Maximum cursor multiplier, including the 1x base speed
```

## dts/bindings/input_processors/custom,input-processor-aml-gate.yaml
```yaml
# SPDX-License-Identifier: MIT
description: Arm the auto-mouse temp layer only after real ball travel (ignores micro-vibration)
compatible: "custom,input-processor-aml-gate"
include: ip_zero_param.yaml
properties:
  processor:
    type: phandle
    required: true
    description: The zmk,input-processor-temp-layer instance to drive
  layer:
    type: int
    required: true
  timeout-ms:
    type: int
    default: 0
  threshold:
    type: int
    default: 20
    description: Sensor counts of |dx|+|dy| needed within window-ms before AML starts
  window-ms:
    type: int
    default: 150
```

## dts/bindings/input_processors/custom,input-processor-precision.yaml
```yaml
# SPDX-License-Identifier: MIT
description: Halve pointer X/Y motion while the precision behavior is held
compatible: "custom,input-processor-precision"
include: ip_zero_param.yaml
```
